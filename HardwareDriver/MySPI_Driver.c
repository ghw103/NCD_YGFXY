/***************************************************************************************************
*FileName:MySPI_Driver
*Description:模拟SPI
*Author:xsx
*Data:2016年4月26日17:04:34
***************************************************************************************************/

/***************************************************************************************************/
/******************************************头文件***************************************************/
/***************************************************************************************************/

#include	"MySPI_Driver.h"

/***************************************************************************************************/
/**************************************局部变量声明*************************************************/
/***************************************************************************************************/

/***************************************************************************************************/
/**************************************局部函数声明*************************************************/
/***************************************************************************************************/

/***************************************************************************************************/
/***************************************************************************************************/
/***************************************正文********************************************************/
/***************************************************************************************************/
/***************************************************************************************************/
/***************************************************************************************************/

/***************************************************************************************************
*FunctionName：SPI1_Init
*Description：SPI端口初始化
*Input：None
*Output：None
*Author：xsx
*Data：2016年4月22日16:41:10
***************************************************************************************************/
void MySPI_Init(void)
{
	GPIO_InitTypeDef  GPIO_InitStructure;
	
	RCC_AHB1PeriphClockCmd(RCC_AHB1Periph_GPIOB, ENABLE);//使能GPIOA时钟
 
	GPIO_InitStructure.GPIO_Pin = GPIO_Pin_14;
	GPIO_InitStructure.GPIO_Mode = GPIO_Mode_IN;
	GPIO_InitStructure.GPIO_OType = GPIO_OType_PP;
	GPIO_InitStructure.GPIO_Speed = GPIO_Speed_100MHz;
	GPIO_InitStructure.GPIO_PuPd = GPIO_PuPd_UP;
	GPIO_Init(GPIOB, &GPIO_InitStructure);
	
	GPIO_InitStructure.GPIO_Pin = GPIO_Pin_12 | GPIO_Pin_13 | GPIO_Pin_15;
	GPIO_InitStructure.GPIO_Mode = GPIO_Mode_OUT;
	GPIO_InitStructure.GPIO_OType = GPIO_OType_PP;
	GPIO_InitStructure.GPIO_Speed = GPIO_Speed_100MHz;
	GPIO_InitStructure.GPIO_PuPd = GPIO_PuPd_UP;
	GPIO_Init(GPIOB, &GPIO_InitStructure);
}


/***************************************************************************************************
*FunctionName：SPI1_ReadWriteByte
*Description：SPI1读写一个字节
*Input：None
*Output：None
*Author：xsx
*Data：2016年4月22日16:41:56
***************************************************************************************************/
unsigned char	MySPI_ReadWriteByte(unsigned char byte)
{
	u8 i,Temp=0;
    for(i=0;i<8;i++)                         // ??8?
    {
        MySPI_CLK_L;                           //????
        if(byte&0x80) MySPI_MOSI_H;                                //??????,????
        else          MySPI_MOSI_L;                              //??????,????
        byte <<= 1;                           // ?????????
        MySPI_CLK_H;                           //????
        Temp <<= 1;                           //????
        if(MySPI_MISO_IN()) Temp++;                       //??????????,?????
        MySPI_CLK_L;                           //????      
    }
    return (Temp);                              //????
}

