/***************************************************************************************************
*FileName：MAX4051_Driver
*Description：控制放大倍数
*Author：xsx
*Data：2015年8月26日14:30:46
***************************************************************************************************/

/***************************************************************************************************/
/******************************************头文件***************************************************/
/***************************************************************************************************/

#include	"MAX4051_Driver.h"


/***************************************************************************************************/
/**************************************局部变量声明*************************************************/
/***************************************************************************************************/
static unsigned char GB_Channel = 1;
/***************************************************************************************************/
/**************************************局部函数声明*************************************************/
/***************************************************************************************************/

/***************************************************************************************************/
/***************************************************************************************************/
/***************************************正文********************************************************/
/***************************************************************************************************/
/***************************************************************************************************/
/***************************************************************************************************/

/***************************************************************************************************
*FunctionName：MAX4051_Init
*Description：放大倍数控制驱动
*Input：None
*Output：None
*Author：xsx
*Data：2016年5月25日19:31:09
***************************************************************************************************/
void MAX4051_Init(void)
{
	GPIO_InitTypeDef GPIO_InitStructure;
	RCC_AHB1PeriphClockCmd(MAX_A_Rcc | MAX_B_Rcc | MAX_C_Rcc, ENABLE);

  	GPIO_InitStructure.GPIO_Pin = MAX_A_Pin; 
  	GPIO_InitStructure.GPIO_Mode = GPIO_Mode_OUT;
	GPIO_InitStructure.GPIO_OType = GPIO_OType_PP;
	GPIO_InitStructure.GPIO_Speed = GPIO_Speed_100MHz;
	GPIO_InitStructure.GPIO_PuPd = GPIO_PuPd_UP;
	GPIO_Init(MAX_A_GpioGroup, &GPIO_InitStructure);
	
	GPIO_InitStructure.GPIO_Pin = MAX_B_Pin;
	GPIO_Init(MAX_B_GpioGroup, &GPIO_InitStructure);
	
	GPIO_InitStructure.GPIO_Pin = MAX_C_Pin;
	GPIO_Init(MAX_C_GpioGroup, &GPIO_InitStructure);
	
	SelectChannel(1);
}

/***************************************************************************************************
*FunctionName：SelectChannel
*Description：选择放大倍数（0 - 7 共8个倍率）
*Input：None
*Output：None
*Author：xsx
*Data：2016年5月25日19:30:29
***************************************************************************************************/
void SelectChannel(unsigned char index)
{
	if(index > 7)
		index = 7;
	
	if(index&0x04)
		MAX_C_H();
	else
		MAX_C_L();
	
	if(index&0x02)
		MAX_B_H();
	else
		MAX_B_L();
	
	if(index&0x01)
		MAX_A_H();
	else
		MAX_A_L();
	
	GB_Channel = index;
}

unsigned char GetChannel(void)
{
	return GB_Channel;
}

