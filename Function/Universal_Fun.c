/***************************************************************************************************
*FileName:SDFunction
*Description:一些SD卡的操作函数
*Author:xsx
*Data:2016年4月30日16:06:36
***************************************************************************************************/


/***************************************************************************************************/
/******************************************头文件***************************************************/
/***************************************************************************************************/
#include	"Universal_Fun.h"

#include	"RTC_Driver.h"
#include	"CardStatues_Data.h"
#include	"CardLimit_Driver.h"
#include	"System_Data.h"
#include	"DS18b20_Driver.h"

#include	"Define.h"

#include 	"FreeRTOS.h"
#include 	"task.h"
#include 	"queue.h"
#include	"semphr.h"

#include	<string.h>
#include	"stdio.h"
#include 	"stdlib.h"


/***************************************************************************************************/
/**************************************局部变量声明*************************************************/
/***************************************************************************************************/

/***************************************************************************************************/
/**************************************局部函数声明*************************************************/
/***************************************************************************************************/





/***************************************************************************************************/
/***************************************************************************************************/
/***************************************正文********************************************************/
/***************************************************************************************************/
/***************************************************************************************************/
/***************************************************************************************************/

void CheckCardStatues(void)
{
	
	if(CardPinIn)
		SetCardState(CardIN);
	else
		SetCardState(NoCard);
}

void UpDateGB_Time(void)
{
	MyTime_Def time ;
	
	if(My_Pass == RTC_GetTimeData(&time))
		SetGB_Time(&time);
}

void ReadEnvironmentTemperature(void)
{
	static unsigned char index = 0;
	float tempv = 0;

	if(index % 2 == 0)
	{
		startDS18B20();
	}
	else
	{
		tempv = readDS18B20Temp();
		if(tempv != 300)
			SetGB_EnTemperature(tempv);
	}
	
	index++;
}
